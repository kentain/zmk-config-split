## drivers/hall_trackball/Kconfig.hall_trackball
```kconfig
menuconfig "Hall Trackball Driver"
bool "Enable Blackberry Hall Effect Trackball + Click"
default n
depends on GPIO
help
4x LUT quadrature decoding for Hall sensors.
GPIO-based left-click with debounce.
HID mouse reports at 200Hz.

if HALL_TRACKBALL_DRIVER

config HALL_TRACKBALL_XPLUS_GPIO
int "X+ GPIO pin (Right motion)"
default 10
depends on GPIO

config HALL_TRACKBALL_XMINUS_GPIO
int "X- GPIO pin (Left motion)"
default 11
depends on GPIO

config HALL_TRACKBALL_YPLUS_GPIO
int "Y+ GPIO pin (Up motion)"
default 12
depends on GPIO

config HALL_TRACKBALL_YMINUS_GPIO
int "Y- GPIO pin (Down motion)"
default 13
depends on GPIO

config HALL_TRACKBALL_BTN_GPIO
int "Button GPIO pin (Left click)"
default 10
depends on GPIO

endif # HALL_TRACKBALL_DRIVER
```

## drivers/input/bb_trackball/Kconfig
```kconfig
config BB_TRACKBALL
    bool "Blackberry Trackball Driver"
    default y
    depends on DT_HAS_ZMK_INPUT_BB_TRACKBALL_ENABLED
    select INPUT
    help
      Driver for Blackberry style trackball with 4 GPIO directional outputs.
```

## dts/bindings/input/my,hall-trackball.yaml
```yaml
description: Hall effect quadrature trackball with optional click button

compatible: "my,hall-trackball"

include:
  - name: base.yaml

properties:
  xplus-gpios:
    type: phandle-array
    required: true
  xminus-gpios:
    type: phandle-array
    required: true
  yplus-gpios:
    type: phandle-array
    required: true
  yminus-gpios:
    type: phandle-array
    required: true
  btn-gpios:
    type: phandle-array
    required: false

  scale:
    type: int
    required: false
    default: 4
    description: Multiplier applied to delta counts before reporting REL_X/REL_Y.
```

## dts/bindings/input/zmk,input-bb-trackball.yaml
```yaml
description: Blackberry Trackball (4 GPIOs)
compatible: "zmk,input-bb-trackball"
include: [sensor-device.yaml]

properties:
  up-gpios:
    type: phandle-array
    required: true
  down-gpios:
    type: phandle-array
    required: true
  left-gpios:
    type: phandle-array
    required: true
  right-gpios:
    type: phandle-array
    required: true
```

## modules/hall_trackball/dts/bindings/input/my,hall-trackball.yaml
```yaml
description: Hall effect quadrature trackball with optional click button

compatible: "my,hall-trackball"

include:
  - name: base.yaml

properties:
  xplus-gpios:  { type: phandle-array, required: true }
  xminus-gpios: { type: phandle-array, required: true }
  yplus-gpios:  { type: phandle-array, required: true }
  yminus-gpios: { type: phandle-array, required: true }
  btn-gpios:    { type: phandle-array, required: false }

  scale:
    type: int
    required: false
    default: 4
    description: Multiply decoded delta counts before reporting REL_X/REL_Y.
```
